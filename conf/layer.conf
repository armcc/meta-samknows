## conf/layer.conf
```bitbake
BBPATH .= ":${LAYERDIR}"

BBFILES += "\
            ${LAYERDIR}/recipes-*/*/*.bb \
            ${LAYERDIR}/recipes-*/*/*.bbappend \
           "

BBFILE_COLLECTIONS += "samknows"
BBFILE_PATTERN_samknows = "^${LAYERDIR}/"
BBFILE_PRIORITY_samknows = "25"

LAYERSERIES_COMPAT_samknows = "rocko sumo thud warrior zeus"
```
